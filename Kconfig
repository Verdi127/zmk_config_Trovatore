## Kconfig
```kconfig
menu "Trovatore Custom"

config TROVATORE_DUAL_OLED_APP
    bool "Enable Trovatore dual OLED support"
    default y
    depends on DISPLAY

endmenu
```

## boards/shields/Trovatore/Kconfig.defconfig
```kconfig
# Required files for ZMK to recognize the shield

if TROVATORE

# Name must be less than 16 characters long!
config ZMK_KEYBOARD_NAME
    default "Trovatore"

endif
```

## boards/shields/Trovatore/Kconfig.shield
```kconfig
# Required files for ZMK to recognize the shield

# No whitespace after the comma or in your keyboard name!
# Config name will be reused in Kconfig.defconfig

config TROVATORE
    def_bool $(shields_list_contains,Trovatore)
 
```

## config/west.yml
```yaml
manifest:
  defaults:
    revision: v0.3
  remotes:
    - name: zmkfirmware
      url-base: https://github.com/zmkfirmware 
    - name: englmaxi
      url-base: https://github.com/englmaxi
    - name: mctechnology17
      url-base: https://github.com/mctechnology17

    # Additional modules containing boards/shields/custom code can be listed here as well
    # See https://docs.zephyrproject.org/3.2.0/develop/west/manifest.html#projects
  projects:
    - name: zmk
      remote: zmkfirmware
      import: app/west.yml
    - name: zmk-dongle-display
      remote: englmaxi
      revision: main
    - name: zmk-nice-oled
      remote: mctechnology17
      revision: main
  self:
    path: config
```
